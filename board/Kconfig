## board/Kconfig
```kconfig
menu "Hardware Drivers Config"

config SOC_STM32F103RE
    bool
    select SOC_SERIES_STM32F1
    select RT_USING_COMPONENTS_INIT
    select RT_USING_USER_MAIN
    default y

menu "Onboard Peripheral Drivers"
    config BSP_USING_USB_TO_USART
        bool "Enable USB TO USART (uart1)"
        select BSP_USING_UART
        select BSP_USING_UART1
        default y
	config BSP_USING_SPI_FLASH
        bool "Enable SPI FLASH (spi2)"
        select BSP_USING_SPI
        select BSP_USING_SPI2
        select PKG_USING_FAL
        select FAL_USING_SFUD_PORT
        select RT_USING_SFUD
        default n	
endmenu

menu "On-chip Peripheral Drivers"

    config BSP_USING_GPIO
        bool "Enable GPIO"
        select RT_USING_PIN
        default y

    menuconfig BSP_USING_UART
        bool "Enable UART"
        default y
        select RT_USING_SERIAL
        if BSP_USING_UART
            config BSP_USING_UART1
                bool "Enable UART1"
                default y

            config BSP_UART1_RX_USING_DMA
                bool "Enable UART1 RX DMA"
                depends on BSP_USING_UART1 && RT_SERIAL_USING_DMA
                default y
				
			config BSP_USING_UART2
                bool "Enable UART2"
                default y
			
			config BSP_USING_UART3
                bool "Enable UART3"
                default y	
        endif

	menuconfig BSP_USING_CAN
        bool "Enable CAN"
        default y
        select RT_USING_CAN
        if BSP_USING_CAN
            config BSP_CAN_USING_HDR
                bool "Enable CAN using hdr"
				select RT_CAN_USING_HDR
                default y	
			config BSP_USING_CAN1
				bool "Enable CAN1"
				default y
        endif
		
    menuconfig BSP_USING_SPI
        bool "Enable SPI"
        default n
        select RT_USING_SPI
        if BSP_USING_SPI
            config BSP_USING_SPI2
                bool "Enable SPI2"
                default n
        endif
		
	    config BSP_USING_ON_CHIP_FLASH
        bool "Enable on-chip FLASH"
        default n 	
		
	menuconfig BSP_USING_TIM
        bool "Enable timer"
        default n
        select RT_USING_HWTIMER
        if BSP_USING_TIM
            config BSP_USING_TIM3
                bool "Enable TIM3"
                default n
        endif
		
	menuconfig BSP_USING_PULSE_ENCODER
        bool "Enable Pulse Encoder"
        default y
        select RT_USING_PULSE_ENCODER
        if BSP_USING_PULSE_ENCODER
            config BSP_USING_PULSE_ENCODER3
                bool "Enable Pulse Encoder3"
                default n
            config BSP_USING_PULSE_ENCODER4
                bool "Enable Pulse Encoder4"
                default y
			config BSP_USING_PULSE_ENCODER8
                bool "Enable Pulse Encoder8"
                default y
        endif		

	menuconfig BSP_USING_PWM
        bool "Enable PWM"
        default y
        select RT_USING_PWM
        if BSP_USING_PWM
		menuconfig BSP_USING_PWM2
            bool "Enable timer2 output PWM"
            default y
            if BSP_USING_PWM2
                config BSP_USING_PWM2_CH2
                    bool "Enable PWM2 channel2"
                    default y
                config BSP_USING_PWM2_CH3
                    bool "Enable PWM2 channel3"
                    default y					
				config BSP_USING_PWM2_CH4
                    bool "Enable PWM2 channel4"
                    default y
            endif
        endif

    menuconfig BSP_USING_ADC
        bool "Enable ADC"
        default y
        select RT_USING_ADC
        if BSP_USING_ADC
            config BSP_USING_ADC1
                bool "Enable ADC1"
                default y
        endif
		
    config BSP_USING_WDT
        bool "Enable Watchdog Timer"
        select RT_USING_WDT
        default y

    source "../libraries/HAL_Drivers/Kconfig"
       
endmenu

menu "Board extended module Drivers"

endmenu

endmenu
```
